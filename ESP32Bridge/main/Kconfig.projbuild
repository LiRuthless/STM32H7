## ESP32Bridge/main/Kconfig.projbuild
```kconfig
menu "ESP32Bridge"

    config BRIDGE_AP_PASSWORD
        string "Local WPA2 SoftAP password (never publish sdkconfig)"
        default ""
        help
            Supply 8 to 63 ASCII bytes in .local/sdkconfig.local.
            Empty or invalid credentials stop configuration; there is no open AP fallback.
            This value is secret. Do not publish menuconfig, sdkconfig or build caches.

endmenu
```

## ESP32Bridge/sdkconfig.defaults
```kconfig
CONFIG_IDF_TARGET="esp32s3"
# CONFIG_SPIRAM is not set
# CONFIG_FREERTOS_UNICORE is not set
CONFIG_SPI_SLAVE_ISR_IN_IRAM=y
CONFIG_GPIO_CTRL_FUNC_IN_IRAM=y
```
